## boards/shields/zmk-oled-gifs-module/Kconfig.defconfig
```kconfig
if SHIELD_ZMK_OLED_GIFS_MODULE

config LV_Z_VDB_SIZE
    default 64

config LV_DPI_DEF
    default 148

config LV_Z_BITS_PER_PIXEL
    default 1

choice LV_COLOR_DEPTH
    default LV_COLOR_DEPTH_1
endchoice

config LV_Z_MEM_POOL_SIZE
    default 4096 if ZMK_DISPLAY_STATUS_SCREEN_CUSTOM

config NICE_OLED_ROTATE_270
    bool "Rotate the portrait view counter-clockwise"
    default n
    help
      Change this if the OLED is mounted in the opposite direction.

config NICE_OLED_VIEWER
    bool
    default y if ZMK_DISPLAY
    select LV_USE_CANVAS
    select LV_USE_IMG
    select LV_FONT_UNSCII_8

endif
```

## boards/shields/zmk-oled-gifs-module/Kconfig.shield
```kconfig
config SHIELD_ZMK_OLED_GIFS_MODULE
    def_bool $(shields_list_contains,zmk_oled_gifs_module)
```

## dts/bindings/behaviors/zmk,behavior-oled-gif-cycle.yaml
```yaml
# Copyright (c) 2024 The ZMK Contributors
# SPDX-License-Identifier: MIT

description: |
  Cycle through all GIFs registered via ZMK_OLED_GIF_DEFINE().
  Each press advances to the next registered animation.

  IMPORTANT: the keymap node name must be <= 8 characters because
  this behavior uses BEHAVIOR_LOCALITY_GLOBAL (runs on both halves).

  Example keymap usage:
    behaviors {
        gif_cyc: gif_cyc {
            compatible = "zmk,behavior-oled-gif-cycle";
            #binding-cells = <0>;
        };
    };
    // Then bind: &gif_cyc

compatible: "zmk,behavior-oled-gif-cycle"

include: zero_param.yaml

properties:
  "#binding-cells":
    type: int
    const: 0
```
